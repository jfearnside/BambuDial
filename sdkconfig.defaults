## sdkconfig.defaults
```kconfig
# Target
CONFIG_IDF_TARGET="esp32s3"

# Flash size
CONFIG_ESPTOOLPY_FLASHSIZE_8MB=y

# Custom partition table with OTA support
CONFIG_PARTITION_TABLE_CUSTOM=y
CONFIG_PARTITION_TABLE_CUSTOM_FILENAME="partitions.csv"

# No PSRAM on M5Dial
CONFIG_SPIRAM=n

# MQTT
CONFIG_MQTT_BUFFER_SIZE=4096
CONFIG_MQTT_TRANSPORT_SSL=y

# LWIP
CONFIG_LWIP_MAX_SOCKETS=10

# mbedTLS - fixed 16KB buffer (standard TLS record size)
CONFIG_MBEDTLS_SSL_MAX_CONTENT_LEN=16384

# HTTP Server (for setup portal)
CONFIG_HTTPD_MAX_REQ_HDR_LEN=1024
CONFIG_HTTPD_MAX_URI_LEN=512
CONFIG_HTTPD_SERVER_STACK_SIZE=8192

# FreeRTOS
CONFIG_FREERTOS_HZ=1000

# LVGL
CONFIG_LV_MEM_SIZE_KILOBYTES=48
CONFIG_LV_USE_PERF_MONITOR=n
CONFIG_LV_FONT_MONTSERRAT_10=y
CONFIG_LV_FONT_MONTSERRAT_12=y
CONFIG_LV_FONT_MONTSERRAT_14=y
CONFIG_LV_FONT_MONTSERRAT_36=y
```
